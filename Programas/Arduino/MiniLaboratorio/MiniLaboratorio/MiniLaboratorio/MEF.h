// MEF.h

#ifndef _MEF_h
#define _MEF_h

#if defined(ARDUINO) && ARDUINO >= 100
	#include "arduino.h"
#else
	#include "WProgram.h"
#endif


/*******************************************************************************
* image
* filename: unsaved
* name: Clock16bitsNew
*
* preset name: Color R5G6B5
* data block size: 16 bit(s), uint16_t
* RLE compression enabled: no
* conversion type: Color, not_used not_used
* bits per pixel: 16
*
* preprocess:
*  main scan direction: top_to_bottom
*  line scan direction: forward
*  inverse: no
*******************************************************************************/


 typedef struct {
	 const uint16_t *data;
	 uint16_t width;
	 uint16_t height;
	 uint8_t dataSize;
	 } tImage;


#include <stdint.h>

static const uint16_t Clock16bitsNew[1024] = {
	0x0000, 0x0000, 0x0000, 0x0000, 0xf3c0, 0xfba0, 0xfbc0, 0xfc00, 0xfc00, 0xfc00, 0xfbe0, 0xfbc0, 0xc300, 0x0000, 0x0000, 0x0000, 0x0000, 0x0000, 0x0000, 0xc300, 0xfbc0, 0xfbe0, 0xfc00, 0xfc00, 0xfc00, 0xfbc0, 0xfba0, 0xf3c0, 0x0000, 0x0000, 0x0000, 0x0000,
	0x0000, 0x0000, 0x0000, 0xfc43, 0xf468, 0xeae0, 0xfbe0, 0xfc21, 0xfc21, 0xfbc0, 0xf360, 0xeb00, 0xf401, 0x0000, 0x0000, 0x0000, 0x0000, 0x0000, 0x0000, 0xf3e1, 0xeb00, 0xf360, 0xfbc0, 0xfc21, 0xfc21, 0xfbe0, 0xeb00, 0xf489, 0xfc64, 0x0000, 0x0000, 0x0000,
	0x0000, 0x0000, 0xc300, 0xf320, 0xeb42, 0xfc44, 0xfce7, 0xfd08, 0xfca7, 0xf361, 0xeae0, 0xf360, 0x0000, 0xcf1d, 0xefbf, 0xdf7e, 0xbe7a, 0x9556, 0xa5b8, 0x0000, 0xf340, 0xeae0, 0xf381, 0xfca7, 0xfd08, 0xfce7, 0xfc44, 0xeb42, 0xf340, 0xc2e0, 0x0000, 0x0000,
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	0x0000, 0x0000, 0x0000, 0x0000, 0x0000, 0x0000, 0x1105, 0x1946, 0x0021, 0x0000, 0x0000, 0x0000, 0x0000, 0x0000, 0x0000, 0x0000, 0x0000, 0x0000, 0x0000, 0x0000, 0x0000, 0x0000, 0x0000, 0x0021, 0x1946, 0x1125, 0x0000, 0x0000, 0x0000, 0x0000, 0x0000, 0x0000
};
const tImage _Clock16bitsNew = { Clock16bitsNew, 32, 32,
	16 };


// Includes //
#include "Display.h"
#include "Display_Menu_Select_Rele.h"
#include "Display_Estate_Init.h"
#include "Display_Menu_Select_Home.h"
#include "Display_Menu_Init.h"

// Functions //
void MEF_Init(void);
void MEF_Updated(void);
void Menu_Actual(void);
extern void Push_Antirrebote(void);

// Variables //
extern bool Est_Task_Menu, Est_Task_Blink, Est_Task_Encoder;
extern uint8_t	maxSteps, minSteps;
typedef enum
{
	ESTATE_INIT,
	ESTATE_IDLE,
	ESTATE_MENU,
	ESTATE_ENCODER,
	ESTATE_BLINK,
}MEFestate_t;
MEFestate_t Actual_Estate;

typedef enum
{
	MENU_INIT,
	MENU_SELECT_HOME,
	MENU_SELECT_RELE,
	MENU_SELECT_THEME,
	MENU_SELECT_RTC,
}MENUestate_t;
MENUestate_t Actual_Menu;
// End //

// ************************************************** //
void MEF_Init(void)
{
	Actual_Estate = ESTATE_INIT;
	Actual_Menu = MENU_INIT;

	return;
}

void MEF_Updated(void)
{
	switch (Actual_Estate)
	{
	case ESTATE_INIT:
	{
		//Display_ESTATE_INIT();

		Actual_Estate = ESTATE_MENU;
		break;
	}
	case ESTATE_IDLE:
	{
		if (Est_Task_Blink == true)			Actual_Estate = ESTATE_BLINK;
		else if (Est_Task_Menu == true)		Actual_Estate = ESTATE_MENU;
		else if (Est_Task_Encoder == true)	Actual_Estate = ESTATE_ENCODER;
		
		break;
	}
	case ESTATE_MENU:
	{
		Menu_Actual();

		Est_Task_Menu == false;

		// Transition //
		Actual_Estate = ESTATE_IDLE;
		break;
	}
	case ESTATE_ENCODER:
	{
		if (digitalRead(ENCODER_B_READ) == HIGH && digitalRead(19) == LOW)		Opc++;
		else if (digitalRead(ENCODER_B_READ) == LOW && digitalRead(19) == LOW)	Opc--;

		if (Opc > maxSteps)			Opc = maxSteps;
		else if (Opc < minSteps)	Opc = minSteps;

		Est_Task_Encoder == false;

		// Transition //
		Actual_Estate = ESTATE_IDLE;
		break;
	}
	case ESTATE_BLINK:
	{
		BLINK;

		Est_Task_Blink == false;

		// Tansition //
		Actual_Estate = ESTATE_IDLE;
		break;
	}
	}

	return;
}

void Menu_Actual(void)
{
	switch (Actual_Menu)
	{
	case MENU_INIT:
	{
		Display_MENU_INIT();
		Opc = 1;

		tft.drawRGBBitmap (10, 10, Clock16bitsNew, 32, 32);

		Actual_Menu = MENU_SELECT_HOME;
		break;
	}
	case MENU_SELECT_HOME:
	{
		uint8_t B_est,A_est;

		maxSteps = 3;
		minSteps = 1;

		Display_MENU_SELECT_HOME();
		
		tft.setCursor(10, 210);
		tft.setTextColor(actual_theme.letterColour, actual_theme.backgroundletterColour);
		tft.print(Opc);
		
		B_est = digitalRead(ENCODER_B_READ);
		tft.setCursor(100, 210);
		tft.print("B:"),tft.print(B_est);
		A_est = digitalRead(19);
		tft.setCursor(50, 210);
		tft.print("A:"),tft.print(A_est);

		//if (Opc == 1 && digitalRead(ENCODER_PUSH_READ))	Push_Antirrebote(),Actual_Menu = MENU_SELECT_RELE;
		//if (Opc == 2 && digitalRead(ENCODER_PUSH_READ))	Push_Antirrebote(), Actual_Menu = MENU_SELECT_RTC;

		break;
	}
	case MENU_SELECT_RELE:
	{


		break;
	}
	case MENU_SELECT_RTC:
	{


		break;
	}
	case MENU_SELECT_THEME:
	{


		break;
	}
	}

	return;
}
// ************************************************** //





#endif

